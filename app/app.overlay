/ {
    leds {
        compatible = "gpio-leds";
        /*
        * led_0 is pin 1 on gpio0.
        * The LED is on when the pin is low, and off when the pin is high.
        */
        led0: led_0 {
        gpios = <&gpio0 1 GPIO_ACTIVE_LOW>;
        };
    };

    aliases {
        app-led = &led0;
    };
};
