## app/Kconfig
```kconfig
config APP_HEARTBEAT_PERIOD_MS
    int "App heartbeat period (ms)"
    range 100 2000

source "Kconfig.zephyr"
```

## app/boards/custom_board_copy/board.yml
```yaml
board:
  name: custom_board_copy
  full_name: my_custom_board_copy_method
  vendor: custom
  socs:
  - name: mcxa156
```

## app/boards/custom_board_scratch/Kconfig.defconfig
```kconfig
if BOARD_CUSTOM_BOARD_SCRATCH

if NETWORKING
    config NET_L2_ETHERNET
    default y
    
endif # NETWORKING

endif # BOARD_CUSTOM_BOARD_SCRATCH
```

## app/boards/custom_board_scratch/board.yml
```yaml
board:
  name: custom_board_scratch
  full_name: my_custom_board_scratch_method
  vendor: custom
  socs:
  - name: mcxa156
```

## boards/custom_board_copy/Kconfig.custom_board_copy
```kconfig
# Copyright 2024 NXP
# SPDX-License-Identifier: Apache-2.0

config BOARD_CUSTOM_BOARD_COPY
	select SOC_MCXA156 if BOARD_CUSTOM_BOARD_COPY
	select SOC_PART_NUMBER_MCXA156VLL
```
